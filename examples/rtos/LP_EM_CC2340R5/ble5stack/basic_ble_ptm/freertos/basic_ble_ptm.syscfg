/*
 * Copyright (c) 2018, Texas Instruments Incorporated
 * All rights reserved.
 *
 * Redistribution and use in source and binary forms, with or without
 * modification, are permitted provided that the following conditions
 * are met:
 *
 * *  Redistributions of source code must retain the above copyright
 *    notice, this list of conditions and the following disclaimer.
 *
 * *  Redistributions in binary form must reproduce the above copyright
 *    notice, this list of conditions and the following disclaimer in the
 *    documentation and/or other materials provided with the distribution.
 *
 * *  Neither the name of Texas Instruments Incorporated nor the names of
 *    its contributors may be used to endorse or promote products derived
 *    from this software without specific prior written permission.
 *
 * THIS SOFTWARE IS PROVIDED BY THE COPYRIGHT HOLDERS AND CONTRIBUTORS "AS IS"
 * AND ANY EXPRESS OR IMPLIED WARRANTIES, INCLUDING, BUT NOT LIMITED TO,
 * THE IMPLIED WARRANTIES OF MERCHANTABILITY AND FITNESS FOR A PARTICULAR
 * PURPOSE ARE DISCLAIMED. IN NO EVENT SHALL THE COPYRIGHT OWNER OR
 * CONTRIBUTORS BE LIABLE FOR ANY DIRECT, INDIRECT, INCIDENTAL, SPECIAL,
 * EXEMPLARY, OR CONSEQUENTIAL DAMAGES (INCLUDING, BUT NOT LIMITED TO,
 * PROCUREMENT OF SUBSTITUTE GOODS OR SERVICES; LOSS OF USE, DATA, OR PROFITS;
 * OR BUSINESS INTERRUPTION) HOWEVER CAUSED AND ON ANY THEORY OF LIABILITY,
 * WHETHER IN CONTRACT, STRICT LIABILITY, OR TORT (INCLUDING NEGLIGENCE OR
 * OTHERWISE) ARISING IN ANY WAY OUT OF THE USE OF THIS SOFTWARE,
 * EVEN IF ADVISED OF THE POSSIBILITY OF SUCH DAMAGE.
 */
// @cliArgs --board /ti/boards/LP_EM_CC2340R5 --rtos freertos

/*
 *  basic_ble.syscfg
 */

const lpName = system.getScript("/ti/ble5stack/ble_common.js").getBoardOrLaunchPadName(true);

/* ======== AESCCM ======== */
var AESCCM = scripting.addModule("/ti/drivers/AESCCM");
var aesccm = AESCCM.addInstance();
aesccm.$name = "CONFIG_AESCCM0";

/* ======== AESECB ======== */
var AESECB = scripting.addModule("/ti/drivers/AESECB");
var aesecb = AESECB.addInstance();
aesecb.$name = "CONFIG_AESECB0";

/* ======== ECDH ======== */
var ECDH = scripting.addModule("/ti/drivers/ECDH");
var ecdh = ECDH.addInstance();
ecdh.$name = "CONFIG_ECDH0"

/* ======== AESCTRDRBG ======== */
var AESCTRDRBG = scripting.addModule("/ti/drivers/AESCTRDRBG");
var aesctrdrbg = AESCTRDRBG.addInstance();

/* ======== Display ======== */
var Display = scripting.addModule("/ti/display/Display");
var displayUART = Display.addInstance();
displayUART.$hardware = system.deviceData.board.components.XDS110UART;
displayUART.enableANSI = true;
displayUART.uartBufferSize = 128;
displayUART.uart.txPinInstance.outputState = "High";
displayUART.uart.$name = "CONFIG_DISPLAY_UART";
displayUART.uart.txPinInstance.$name = "CONFIG_PIN_UART_TX";
displayUART.uart.rxPinInstance.$name = "CONFIG_PIN_UART_RX";

/* ======== GPIO ======== */
var GPIO  = scripting.addModule("/ti/drivers/GPIO", {}, false);
var GPIO3 = GPIO.addInstance();
var GPIO4 = GPIO.addInstance();

GPIO3.$name = "CONFIG_GPIO_BTN1";
GPIO3.$hardware = system.deviceData.board.components["BTN-1"];

GPIO4.$name = "CONFIG_GPIO_BTN2";
GPIO4.$hardware = system.deviceData.board.components["BTN-2"];

/* ======== NVS ======== */
var NVS = scripting.addModule("/ti/drivers/NVS");
var nvs = NVS.addInstance();
nvs.internalFlash.regionBase   = 0x70000;
nvs.internalFlash.regionSize   = 0x1000;
nvs.$name = "CONFIG_NVSINTERNAL";

/* ======== RCL ======== */
const RCL = scripting.addModule("/ti/drivers/RCL");

/* ======== POWER ======== */
var Power = scripting.addModule("/ti/drivers/Power");
//* For CC27XX Device Family */
if (lpName.match(/CC27\d\d/))
{
    Power.policyFunction = "PowerCC27XX_doWFI";
}
/* For CC23XX Device Family */
else if (lpName.match(/CC23\d\d/))
{
    Power.policyFunction = "PowerCC23X0_doWFI";
}

/* ======== RNG ======== */
var RNG = scripting.addModule("/ti/drivers/RNG");
var rng = RNG.addInstance();

/* ======== RF Design ======== */
var rfDesign = scripting.addModule("ti/devices/radioconfig/rfdesign");
const rfDesignSettings = system.getScript("/ti/common/lprf_rf_design_settings.js").rfDesignSettings;
for(var setting in rfDesignSettings)
{
    rfDesign[setting] = rfDesignSettings[setting];
}

const radioSettings = system.getScript("/ti/ble5stack/ble_common.js").getRadioScript(rfDesign.rfDesign,system.deviceData.deviceId);
const bleRfDesignSettings = radioSettings.rfDesignParams;
for(var setting in bleRfDesignSettings)
{
    rfDesign[setting] = bleRfDesignSettings[setting];
}

/* ======== Device ======== */
var device = scripting.addModule("ti/devices/CCFG");
const ccfgSettings = system.getScript("/ti/common/lprf_ccfg_settings.js").ccfgSettings;
for(var setting in ccfgSettings)
{
    device[setting] = ccfgSettings[setting];
}

const bleCcfgSettings = system.getScript("/ti/ble5stack/ble_common.js").centralRoleCcfgSettings;
for(var setting in bleCcfgSettings)
{
    device[setting] = bleCcfgSettings[setting];
}

/* ======== FreeRTOS ======== */
const FreeRTOS    = scripting.addModule("/freertos/FreeRTOS");
const Settings    = scripting.addModule("/ti/posix/freertos/Settings");
FreeRTOS.heapSize             = 0x00004A50;
FreeRTOS.timerStackSize       = 0x00000180;
FreeRTOS.idleStackSize        = 0x00000100;

/* ======== BLE ======== */
var ble = scripting.addModule("/ti/ble5stack/ble");
ble.deviceRole = "PERIPHERAL_CFG+CENTRAL_CFG";
ble.basicBLE = true;
ble.disDevBySerUuid = true;
ble.deviceName = "Basic BLE project";
ble.numOfAdvSets = 1;
ble.numOfDefAdvSets = 1;
// Gap Advertising Flags
ble.advSet1.advData1.GAP_ADTYPE_FLAGS = true;
ble.advSet1.advData1.advertisingFlags = ["GAP_ADTYPE_FLAGS_BREDR_NOT_SUPPORTED","GAP_ADTYPE_FLAGS_GENERAL"];
// More 16-bit UUIDs available
ble.advSet1.advData1.GAP_ADTYPE_16BIT_MORE = true;
ble.advSet1.advData1.numOfUUIDs16More = 1;
ble.advSet1.advData1.UUID016More = 65520;
// Complete local name
ble.advSet1.scanRes1.GAP_ADTYPE_LOCAL_NAME_COMPLETE = true;
// Min and Max values of the connection interval - 2 octets Min, 2 octets Max (0xFFFF indicates no conn interval min or max)
const connIntervalRange = system.getScript("/ti/ble5stack/ble_common.js").getPeripheralConnIntervalRange();
ble.advSet1.scanRes1[connIntervalRange] = true;
// Min Connection Interval
ble.advSet1.scanRes1.minConnInterval = 100;
// Max Connection Interval
ble.advSet1.scanRes1.maxConnInterval = 130;
// TX Power Level
ble.advSet1.scanRes1.GAP_ADTYPE_POWER_LEVEL = true;
// Pairing Mode
ble.bondPairing = "GAPBOND_PAIRING_MODE_INITIATE";
//enable ptm
ble.ptm = true;
